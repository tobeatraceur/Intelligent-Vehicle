/********************************************Copyright******************************************************
**                                                                                                      
**
**-------------------------------------------文件信息-------------------------------------------------------
** 文件名称:			Wp_Sys.c
** 最后修订日期:  		2012-10-10
** 最后版本:			1.0
** 描述:				系统初始化文件;
**
**-----------------------------------------------------------------------------------------------------------
** 创建人:				吴康
** 创建日期:			2012-02-09
** 版本:				1.0
** 描述:				系统初始化文件;
**
**-----------------------------------------------------------------------------------------------------------
** 修订人:
** 修订日期:
** 版本:
** 描述:
**
**-----------------------------------------------------------------------------------------------------------
** 修订人:
** 修订日期:
** 版本:
** 描述:
**
*************************************************************************************************************/
#include "Wp_Sys.h"


/*************************************************************************************************************
** 函数名称:			RCC_Configuration
**
** 函数描述:			初始化系统时钟;
** 						
**					    
** 输入变量:			void;
** 返回值:				void;
**
** 使用宏或常量:		None;
** 使用全局变量:		None;
**
** 调用函数:			None;
**
** 创建人:				
** 创建日期:			2011-11-1
**-------------------------------------------------------------------------------------------------------------
** 修订人:
** 修订日期:
**-------------------------------------------------------------------------------------------------------------
***************************************************************************************************************/
static void RCC_Configuration(void)
{
	RCC_ClocksTypeDef RCC_ClockFreq;
	
	/**************************************************
	获取RCC的信息,调试用请参考RCC_ClocksTypeDef结构体的内容,当时钟配置完成后,
	里面变量的值就直接反映了器件各个部分的运行频率
	***************************************************/
	RCC_GetClocksFreq(&RCC_ClockFreq);
	
	/*	这个配置可使外部晶振停振的时候,产生一个NMI中断,不需要用的可屏蔽掉   */
//	RCC_ClockSecuritySystemCmd(ENABLE);
	
	/*	启动系统定时器, SYSTICK分频得到1ms的系统时钟中断 */
	if (SysTick_Config(SystemCoreClock / 1000))
  	{
  	  	/* Capture error */
    	while (1);
  	}
}


/*************************************************************************************************************
** 函数名称:			Wp_SystemConfigure
**
** 函数描述:			初始化系统函数;
** 						
**					    
** 输入变量:			void;
** 返回值:				void;
**
** 使用宏或常量:		None;
** 使用全局变量:		None;
**
** 调用函数:			None;
**
** 创建人:				
** 创建日期:			2011-11-1
**-------------------------------------------------------------------------------------------------------------
** 修订人:
** 修订日期:
**-------------------------------------------------------------------------------------------------------------
***************************************************************************************************************/
void Wp_SystemConfigure(void)
{
//  char *setname = "wukang";           // 初始化BLE名称
    
	SystemInit();						// STM32系统初始化
	RCC_Configuration();				// 初始化系统时钟
    
	Wp_NVIC_Configuration();			// 初始化中断配置
	
	Wp_GpioConfigure(); 				// GPIO配置初始化
    Wp_KeyInit();                       // 按键引脚初始化
    
	Wp_Usart1Configure(115200);		    // Uart1初始化，与上位机通讯接口
	Wp_Usart3Configure(115200);	        // Uart3初始化，与电机模块通讯接口
    
    Wp_Uart1RxDmaInit();
    Wp_Uart1TxDmaInit();
    
	Wp_AdcConfigure();					// ADC初始化
//	UP_Exti_Init();						// EXTI初始化
    
	Wp_OledInit();						// OLED初始化
	Wp_ClearOled();					    // 清屏
//	OLED_P8x16Str(4, 1, "WaterPlus");   // 显示开机界面
    Wp_DisP16x16HanZiArray(3, 1, Name16x16, 0);     // 显示开机界面
    Wp_DisP16x16HanZiArray(4, 1, Name16x16, 1);
    Wp_DisP16x16HanZiArray(1, 2, Name16x16, 2);
    Wp_DisP16x16HanZiArray(2, 2, Name16x16, 3);
    Wp_DisP16x16HanZiArray(3, 2, Name16x16, 4);
    Wp_DisP16x16HanZiArray(4, 2, Name16x16, 5);
    Wp_DisP16x16HanZiArray(5, 2, Name16x16, 6);
    Wp_DisP16x16HanZiArray(6, 2, Name16x16, 7);    
    
	Wp_MPU6050DMP_Init();				// MPU6050初始化    
    Wp_BleKeyInit();                    // BLE模式引脚初始化
    BLEMODE_L;
    
    Wp_DelayMs(500);                    // 点亮500ms
	Wp_ClearOled();					    // 清屏
	
    if (key_up() && key_down())                 // 同时按下向上键和向下键，重新对蓝牙模块进行初始化
    {
        LED1_ON;
        BLEMODE_H;
        Wp_DelayMs(1000);
        LED1_OFF;
        BLEMODE_L;
        
        Wp_Usart2Configure(9600);			    // Uart2初始化，与BLE模块通讯接口
        Wp_DelayMs(500);
        
        Wp_SetBleBaud(4);                       // 设置蓝牙模块的波特率为115200，发两遍测试成功
      Wp_SetBleName("test");                 // 设置蓝牙模块的名称，发两遍测试成功
        
        Wp_DelayMs(500);
        LED1_ON;
        
        Wp_Usart2_SendStr("AT+RESET");          // 复位蓝牙模块，使波特率设置成功
        Wp_DelayMs(1000);
        LED1_OFF;
        Wp_DelayMs(1000);
        LED1_ON;
        
        Wp_Usart2Configure(115200);			    // Uart2初始化，与BLE模块通讯接口
    }
    else
    {
			  //Wp_SetBleBaud(4);
			  //Wp_SetBleName("test");	
        Wp_Usart2Configure(115200);			    // Uart2初始化，与BLE模块通讯接口       
        		
    }

	Wp_Timer2Configure();				        // Timer2初始化，系统伺服周期定时10ms
//	Wp_UserTimerConfigure();			        // Timer3初始化，供用户使用，比较通道0~3作为4个定时器供用户使用    
    
//  Wp_PwmConfigure();                          // PWM初始化
//	Wp_PwmSetFrequency(0, 500);			        // 设置PWM0频率为50Hz（默认50%占空比）
//	Wp_PwmSetDutyTime(0, 4096/2048); 	        // 设置PWM1高电平时长1ms/20ms，模拟舵机输出的波形 
//	Wp_PwmEnable(0, ENABLE);			        // 使能PWM0为PWM输出模式（默认情况下为IO模式）
    
    Wp_FlashSpiConfigure();                     // 初始化片外Flash-SPI总线
    
    UART3RXEN;                                  // 上电接收使能
    keyvalue = 1;                               // 默认显示姿态信息界面
}


/********************************************************************************************************
**                            End Of File
********************************************************************************************************/
